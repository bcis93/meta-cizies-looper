## conf/distro/ciziesdistro.conf
```bitbake
require conf/distro/poky.conf
DISTRO = "ciziesdistro"
DISTRO_NAME = "Cizies Distro"
DISTRO_CODENAME = "cizies"
DISTRO_VERSION = "1.0.0"
MAINTAINER = "Bryan Cisneros <bryancisneros93@gmail.com>"

DISTRO_EXTRA_RDEPENDS = " cizies-looper"

IMAGE_FSTYPES_append = " rpi-sdimg"

RPI_KERNEL_DEVICETREE_OVERLAYS_append = " overlays/fe-pi-audio.dtbo"

INHERIT += "extrausers"
EXTRA_USERS_PARAMS = " useradd cizies; \
                       usermod  -a -G audio cizies; \
"
```

## conf/layer.conf
```bitbake
# We have a conf and classes directory, add to BBPATH
BBPATH .= ":${LAYERDIR}"

# We have recipes-* directories, add to BBFILES
BBFILES += "${LAYERDIR}/recipes-*/*/*.bb \
            ${LAYERDIR}/recipes-*/*/*.bbappend"

BBFILE_COLLECTIONS += "meta-cizies-looper"
BBFILE_PATTERN_meta-cizies-looper = "^${LAYERDIR}/"
BBFILE_PRIORITY_meta-cizies-looper = "6"

LAYERDEPENDS_meta-cizies-looper = "core"
LAYERSERIES_COMPAT_meta-cizies-looper = "dunfell"
```
